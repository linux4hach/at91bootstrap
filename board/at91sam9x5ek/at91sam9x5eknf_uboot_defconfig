## board/at91sam9x5ek/at91sam9x5eknf_uboot_defconfig
```kconfig
CONFIG_AT91SAM9X5EK=y
CONFIG_RAM_128MB=y
CONFIG_NANDFLASH=y
# CONFIG_PMECC_AUTO_DETECT is not set
CONFIG_PMECC_CORRECT_BITS_4=y
# CONFIG_NANDFLASH_RECOVERY is not set
CONFIG_DEBUG=y
CONFIG_THUMB=y
# CONFIG_DISABLE_WATCHDOG is not set
CONFIG_SCLK=y
CONFIG_LOAD_ONE_WIRE=y
```

## defconfig
```kconfig
CONFIG_AT91SAM9X5EK=y
CONFIG_RAM_128MB=y
# CONFIG_DATAFLASH_RECOVERY is not set
CONFIG_DEBUG=y
CONFIG_THUMB=y
# CONFIG_DISABLE_WATCHDOG is not set
CONFIG_SCLK=y
CONFIG_LOAD_ONE_WIRE=y
```
